## hardware/main/Kconfig.projbuild
```kconfig
menu "Example Configuration"

config WIFI_SSID
    string "WiFi SSID"
	default "myssid"
	help
		SSID (network name) for the example to connect to.

config WIFI_PASSWORD
    string "WiFi Password"
	default "myssid"
	help
		WiFi password (WPA or WPA2) for the example to use.

		Can be left blank if the network has no security set.

config SERVER_URI
    string "Server URL to send data"
    default "http://server-host:8000/upload"
    help
        Server URL to send data

config MQTT_HOST
    string "MQTT Broker Host"
    default "broker.example.com"
    help
        MQTT broker IP address or hostname.

config MQTT_PORT
    int "MQTT Broker Port"
    default 1883
    help
        MQTT broker port number.

config MQTT_USERNAME
    string "MQTT Username"
    default "whitebox"
    help
        MQTT broker login username.

config MQTT_PASSWORD
    string "MQTT Password"
    default "change_me"
    help
        MQTT broker login password.
endmenu
```

## hardware/sdkconfig.defaults
```kconfig
#
# Bootloader config
#
CONFIG_BOOTLOADER_OFFSET_IN_FLASH=0x1000
CONFIG_BOOTLOADER_COMPILER_OPTIMIZATION_SIZE=y

#
# Serial flasher config
#
CONFIG_ESPTOOLPY_HEADER_FLASHSIZE_UPDATE=y
CONFIG_ESPTOOLPY_BEFORE_RESET=y
CONFIG_ESPTOOLPY_FLASHFREQ_80M=y
CONFIG_ESPTOOLPY_FLASHSIZE_16MB=y
CONFIG_OPTIMIZATION_LEVEL_RELEASE=y
CONFIG_ESPTOOLPY_FLASHSIZE_16MB=y
# end of Serial flasher config

CONFIG_FREERTOS_ENABLE_BACKWARD_COMPATIBILITY=y
CONFIG_ESP_SYSTEM_EVENT_TASK_STACK_SIZE=4096

#
# Bluetooth - disable BLE to free internal RAM for WiFi/audio
#
# CONFIG_BT_ENABLED is not set

#
# Partition Table
#
CONFIG_PARTITION_TABLE_CUSTOM=y
CONFIG_PARTITION_TABLE_CUSTOM_FILENAME="partitions.csv"
CONFIG_PARTITION_TABLE_FILENAME="partitions.csv"
CONFIG_PARTITION_TABLE_MD5=y
# end of Partition Table

#
# ESP-SR wake word
#
CONFIG_SR_WN_WN9_HIESP=y
CONFIG_SR_MN_CN_MULTINET7_QUANT=y

#
# WiFi - use dynamic buffers to save internal RAM
#
# Static RX buffer minimum is 2 (Kconfig range 2-25), cannot set 0
CONFIG_ESP_WIFI_STATIC_RX_BUFFER_NUM=2
CONFIG_ESP_WIFI_DYNAMIC_RX_BUFFER_NUM=16
# Mgmt frame buffer use dynamic allocation (Kconfig choice type, enable dynamic directly)
# CONFIG_ESP_WIFI_STATIC_RX_MGMT_BUFFER is not set
CONFIG_ESP_WIFI_DYNAMIC_RX_MGMT_BUFFER=y
CONFIG_ESP_WIFI_RX_MGMT_BUF_NUM_DEF=2
CONFIG_ESP_WIFI_MGMT_SBUF_NUM=6
CONFIG_ESP_WIFI_STATIC_TX_BUFFER_NUM=8
CONFIG_ESP_WIFI_CACHE_TX_BUFFER_NUM=8
# CONFIG_ESP_WIFI_AMPDU_RX_ENABLED is not set
# CONFIG_ESP_WIFI_AMPDU_TX_ENABLED is not set
CONFIG_ESP_WIFI_RX_BA_WIN=4
```
